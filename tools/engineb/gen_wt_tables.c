/* gen_wt_tables.c — build eb_dco_wt.c's residual tables from the SHIPPING DCO.
 *
 * WHAT A RESIDUAL IS HERE. eb_dco_wt.c computes each arm's flat value directly
 * -- away from an edge every arm is exactly +/- sat_hi, measured at 98.85 % of
 * sub-steps -- and adds a correction over the few samples an edge spans. The
 * correction is
 *
 *     residual(t) = lowpass(E)(t) - S(t)
 *
 * where E is the PORT'S OWN edge and S is the flat step it replaces. It is
 * generated by RUNNING eb_dco_step, not by modelling the edge, so it cannot
 * drift from the oscillator it corrects.
 *
 * THE TABLE HAS NO PITCH DIMENSION. The edge's width in SAMPLES is
 * |pw-1|/(8*amp) -- inc cancels -- and that was MEASURED at 2.4290 output
 * samples across five octaves (edge_width.c). So one table serves every note,
 * and with the per-voice coefficient spread measured at exactly 0 it serves
 * every voice too.
 *
 * WHAT IT DOES NOT DO. It does not window the residual to zero at its ends.
 * A band-limited step's tail decays as 1/n, so truncating at 32 samples leaves
 * a step of about -30 dB at the join. Whether that matters is a MEASUREMENT
 * the gate makes, not a judgement made here; if it does, the fix is a longer
 * window or a taper, and both are one constant away.
 *
 * Emits a C header on stdout.
 */
#include <stdio.h>
#include <stdlib.h>
#include <string.h>
#include <math.h>
#include "eb_fork_config.h"
#include "eb_dco.h"
#include "eb_decim.h"
#include "eb_dco_wt.h"
#include "c6_realcoefs.h"

#ifndef M_PI
#define M_PI 3.14159265358979323846
#endif

#define OS        64          /* fine steps per OUTPUT sample when building */
/* HALF IS NOW THE FLAT PATH'S DELAY, NOT HALF THE WINDOW. See eb_dco_wt.h:
 * an eight-sample delay is a pure delay of the OSCILLATOR and a timing error
 * inside the VOICE. Both this file and the tick read EB_WT_DELAY. */
#define HALF      (EB_WT_DELAY)
/* THE BUILD PITCH must make the period MUCH longer than the residual window,
 * or a second edge falls inside it. At 0.01 the period is 50 output samples
 * and the 64-sample window always contained two edges -- the pulse residuals
 * came out with a full-height 1.70 spike at one end, which was the OTHER
 * edge's own step. At 0.0005 the period is 1,000 samples and each edge is
 * alone in its window.
 *
 * Choosing the pitch freely is legitimate BECAUSE the residual is
 * pitch-independent, measured at 2.4290 samples across five octaves. */
#ifndef BUILD_INC
#define BUILD_INC 0.0005f
#endif

/* THE BUILD PITCH IS A VARIABLE, NOT A CONSTANT, because ONE ARM NEEDS IT TO
 * BE. The saw's and the pulse's residuals are pitch-independent -- MEASURED,
 * and re-measured here: rebuilding them at 0.0005, 0.005 and 0.02 moves them
 * by under 1.5 dB. The SUB'S IS NOT. Its matched-pitch error is -41.8, -42.9,
 * -54.1 and -58.9 dB at inc 0.0025, 0.005, 0.01 and 0.02, and every
 * off-diagonal entry of that matrix is 10 to 20 dB worse. So the sub gets a
 * MIP DIMENSION and the other two arms do not. */
static float g_build_inc = BUILD_INC;

/* ARM SELECTOR, same convention as the row-6 probe. */
enum { ARM_SAW = 1, ARM_PULSE = 2, ARM_SUB = 3 };

static void fill(eb_dco_coef *c, float inc4, float pw, int arm)
{
    memset(c, 0, sizeof *c);
    c->inc = inc4;
    c->g = 0.00390625f / inc4;
    c->pw = pw; c->pwm1 = pw - 1.0f; c->pwp1 = pw + 1.0f;
#if EB_DCO_RECIP
    c->rm1 = 1.0f / c->pwm1; c->rp1 = 1.0f / c->pwp1;
#endif
    /* LEVEL 1, NOT THE PATCH'S. The residual is a SHAPE; the tick multiplies
     * by the recalled level itself. Using the patch's level here made the saw
     * and sub tables come out ALL ZERO, because patch 32 has DCO SUB LEVEL
     * exactly 0.0f -- a table generator that silently emits zeros because its
     * source patch happens not to use that arm is the kind of vacuous output
     * this project has been caught by before. */
    c->lvl_saw   = (arm == ARM_SAW)   ? 1.0f : 0.0f;
    c->lvl_pulse = (arm == ARM_PULSE) ? 1.0f : 0.0f;
    c->lvl_sub   = (arm == ARM_SUB)   ? 1.0f : 0.0f;
    c->gn_saw = RC_gn_saw;   c->gn_pulse = RC_gn_pulse;   c->gn_sub = RC_gn_sub;
    c->amp_saw = RC_amp_saw; c->amp_pulse = RC_amp_pulse; c->amp_sub = RC_amp_sub;
    c->sat_in = RC_sat_in;   c->subthr = RC_subthr;
    c->k3=RC_k3; c->k5=RC_k5; c->k7=RC_k7; c->k9=RC_k9; c->k11=RC_k11;
    { float x=c->sat_in,x2=x*x,x3=x*x2,x5=x3*x2,x7=x5*x2,x9=x7*x2,x11=x9*x2;
      c->sat_hi = x + x3*c->k3 + x5*c->k5 + x7*c->k7 + x9*c->k9 + x11*c->k11; }
    { float x=-c->sat_in,x2=x*x,x3=x*x2,x5=x3*x2,x7=x5*x2,x9=x7*x2,x11=x9*x2;
      c->sat_lo = x + x3*c->k3 + x5*c->k5 + x7*c->k7 + x9*c->k9 + x11*c->k11; }
#if EB_DCO_PULSEFAST
    eb_dco_set_edge_thresholds(c);
#endif
}

/* Run one full period at OS x the output rate and return the fine trace plus
 * the fine index of the requested edge. `which` picks WHICH crossing: 0 = the
 * phase wrap (saw, and the pulse's fixed edge), 1 = t crossing zero (the
 * pulse's moving edge), 2 = the sub's own crossing. */
static float *trace(float pw, int arm, int which, long *n_out, long *edge_out,
                    float **naive_out, double *height_out,
                    eb_dco_coef *coef_out, double *sub_out, float *phedge,
                    float *uedge)
{
    eb_dco_coef c; eb_dco_state s;
    double sub = (double)g_build_inc * 4.0 / OS;
    /* THE TRACE MUST OUTLAST THE WINDOW ON BOTH SIDES. The residual spans
     * EB_WT_RES_LEN output samples and the reconstruction filter reaches 16
     * more, so an edge needs about 48 output samples of trace either side of
     * it. The first version ran ONE period -- 54 output samples in total --
     * so most of the window fell off the end of the array, the low-pass
     * returned its midpoint, and every residual came out at a flat 0.5
     * instead of decaying to zero. A residual that does not go to zero at its
     * ends is the one thing this table cannot be. */
    long span = (long)((EB_WT_RES_LEN / 2 + 24) * OS);
    long period = (long)(2.0 / sub);
    long n = period * 3 + 2 * span, i, edge = -1, want = n / 2;
    float *v = (float *)malloc(sizeof(float) * (size_t)n);
    /* THE NAIVE TRACE, which is the reference the residual is measured
     * against -- and getting this wrong was the whole of the first two
     * failures. The residual is
     *
     *     lowpass(E)(t) - NAIVE(t)
     *
     * where NAIVE is exactly what eb_dco_wt_tick computes: the arm's flat
     * value with no band-limiting. Subtracting a flat +/-1 STEP instead is
     * only right for a square; the SAW is a RAMP, so its residual came out at
     * a constant 0.5 because the ramp it should have followed was missing. */
    float *nv = (float *)malloc(sizeof(float) * (size_t)n);
    float *phtrace = (float *)malloc(sizeof(float) * (size_t)n);
    /* THE SUB'S OWN RAMP, recorded rather than recomputed. Its argument u
     * depends on the divide-by-two COUNTER, which toggles at the very edge
     * being tabulated, so reconstructing it from the phase alone gets the
     * wrong side of the toggle for half the window. */
    float *utrace = (float *)malloc(sizeof(float) * (size_t)n);
    float pprev;
    memset(&s, 0, sizeof s);
    fill(&c, g_build_inc, pw, arm);
    c.inc = (float)sub;
    /* start well before the edge so the window has room on both sides */
    pprev = s.phase;
    for (i = 0; i < n; ++i) {
        float pnow, t, u;
        float uprev = (i > 0) ? utrace[i - 1] : 0.0f;
        v[i] = eb_dco_step(&s, &c);
        pnow = s.phase;
        t = c.pw + pnow;
        u = (((s.subcnt + pnow) + 1.0f) * 0.5f) - 1.0f;
        phtrace[i] = pnow; utrace[i] = u;
        nv[i] = (arm == ARM_SAW)
              ? (pnow * c.gn_saw) * c.sat_hi * c.lvl_saw
              : (arm == ARM_PULSE)
              ? (t < 0.0f ? -c.gn_pulse : c.gn_pulse)
                * c.sat_hi * c.lvl_pulse
              : (u < 0.0f ? -c.gn_sub : c.gn_sub) * c.sat_hi * c.lvl_sub;
        /* the edge nearest the MIDDLE of the trace, so the window has room
         * on both sides whatever the period turns out to be */
        if (edge < 0 && i > want) {
            if (which == 0 && pnow < pprev) edge = i;
            /* THE NO-WRAP GUARD IS THE TICK'S, and it was missing here. The
             * tick only calls this the pulse's MOVING edge when p >= prev;
             * on a wrap sample t also changes sign, and without the guard the
             * generator called that a moving edge too. */
            if (which == 1 && pnow >= pprev
                && ((pw + pprev) < 0.0f) != ((pw + pnow) < 0.0f))
                edge = i;
            /* THE SUB'S EDGE IS WHERE ITS OWN RAMP CROSSES ZERO, not where
             * the counter is non-zero. The first version tested the counter,
             * which is non-zero for a whole half-period, so it picked an
             * arbitrary flat point and the residual came out all zeros --
             * indistinguishable from a table that simply was not built. */
            if (which == 2 && (uprev < 0.0f) != (u < 0.0f)) edge = i;
        }
        pprev = pnow;
    }
    *n_out = n; *edge_out = edge; *naive_out = nv;
    *coef_out = c; *sub_out = sub;
    *phedge = (edge > 0 && edge < n) ? phtrace[edge] : 0.0f;
    *uedge  = (edge > 0 && edge < n) ? utrace[edge]  : 0.0f;
    free(phtrace); free(utrace);
    /* THE STEP HEIGHT the tick will multiply the residual by. Measured from
     * the naive trace across the edge rather than assembled from constants,
     * so a sign convention cannot drift between here and eb_dco_wt.c. */
    *height_out = (edge > 0 && edge + 1 < n)
                ? (double)nv[edge + 1] - (double)nv[edge - 1] : 1.0;
    return v;
}

/* AN IDEAL LOW-PASS IS THE WRONG BAND-LIMIT, and this is the same lesson the
 * row-6 probe already learned once: the table must carry the PORT'S OWN
 * decimator, whose passband is not flat and whose stopband is not a brick
 * wall. Measured against the real 4x+FIR chain, an ideally-band-limited
 * residual left -11.5 dB at 441 Hz and +10.2 dB at 7 kHz, because the
 * reference's own level falls with pitch (RMS 0.81 -> 0.64 -> 0.23) while an
 * ideal reconstruction holds it flat.
 *
 * So the residual is now built by RUNNING the shipping chain -- eb_dco_step
 * four times into eb_decim_tick -- at each fractional crossing position, and
 * this ideal filter is kept only for the trace-inspection it still does. */
static double lp(const float *v, long n, double at)
{
    const int NT = 16 * OS;
    double acc = 0.0, wsum = 0.0;
    int k;
    for (k = -NT; k <= NT; ++k) {
        long idx = (long)floor(at) + k;
        double x = (double)k - (at - floor(at));
        double w, h;
        if (idx < 0 || idx >= n) continue;
        w = 0.42 - 0.5 * cos(2.0 * M_PI * (k + NT) / (2.0 * NT))
          + 0.08 * cos(4.0 * M_PI * (k + NT) / (2.0 * NT));
        h = (fabs(x) < 1e-12) ? 1.0 / OS
                              : sin(M_PI * x / OS) / (M_PI * x);
        acc += v[idx] * h * w; wsum += h * w;
    }
    return wsum > 1e-12 ? acc / wsum : 0.0;
}

/* THE NAIVE VALUE AT A FRACTIONAL TIME, computed rather than indexed.
 * Indexing the recorded trace at the nearest integer is wrong by a WHOLE STEP
 * whenever the target lands on the far side of an edge -- which it does for
 * exactly the samples that matter -- and that showed up as a 1.7 spike at one
 * end of every pulse residual. The phase is exactly linear between wraps, so
 * it can be reconstructed from the phase AT the edge and the fine increment. */
static double naive_at(const eb_dco_coef *c, int arm, double phe, double dsub,
                       double dt, double ue)
{
    double p = phe + dt * dsub, t, u;
    p = fmod(p + 1.0, 2.0); if (p < 0.0) p += 2.0; p -= 1.0;
    t = (double)c->pw + p;
    /* THE SUB'S SIGN, not its value. Its ramp is
     * u = ((cnt + p + 1)/2) - 1, which is zero exactly when cnt + p = 1 --
     * and with cnt in {0,2} that means p = +/-1, i.e. THE SUB'S CROSSING
     * COINCIDES WITH A PHASE WRAP. So a linear reconstruction of u is wrong on
     * one side of the very edge being tabulated, and it showed up as a
     * full-height step at one end of the residual.
     *
     * Only the SIGN of u reaches the output, and the build pitch is chosen so
     * that the period is far longer than the window -- so within the window
     * the sign flips exactly once, at dt = 0. */
    /* THE DIRECTION IS TAKEN FROM THE TRACE, not assumed. `ue` is u just
     * AFTER the crossing, so its sign says which way this edge goes. Assuming
     * a rising edge put the residual at a flat +/-1 on BOTH sides -- lp and
     * the reference simply had opposite signs everywhere. */
    u = ((dt < 0.0) ? -1.0 : 1.0) * ((ue < 0.0f) ? -1.0 : 1.0);
    if (arm == ARM_SAW)
        return (p * (double)c->gn_saw) * (double)c->sat_hi;
    if (arm == ARM_PULSE)
        return (t < 0.0 ? -(double)c->gn_pulse : (double)c->gn_pulse)
             * (double)c->sat_hi;
    return (u < 0.0 ? -(double)c->gn_sub : (double)c->gn_sub)
         * (double)c->sat_hi;
}

/* Build one residual by RUNNING THE PORT'S OWN CHAIN.
 *
 * For sub-position `o` the oscillator is started `o/OVER` of an output sample
 * earlier, so the edge lands at that fraction through a sample. The chain is
 * eb_dco_step four times into eb_decim_tick -- the exact 4x path this module
 * replaces -- so the residual carries the decimator's response by
 * CONSTRUCTION rather than by a filter designed to imitate it.
 */
/* Returns the fraction the TICK would measure at the edge this built, so the
 * caller can correct and re-run. */
static double build_one(float pw, int arm, int which, int o, float *out,
                        float *nout, double p0_in, double *frac_out)
{
    eb_dco_coef c; eb_dco_state s;
    /* THE FIR ONLY -- NOT eb_decim_tick. That function is the FIR *plus a
     * biquad*, and eb_render.c runs the biquad AGAIN on this module's output
     * (the EB_QUARTER_OS arm keeps it, because it is rate-dependent recall
     * data and not anti-aliasing). Building the residual with eb_decim_tick
     * therefore put the biquad in TWICE.
     *
     * The tap map is the one derived in the row-6 probe: stream p at age a is
     * delayed 4a + (3-p) sub-samples, and the sequence comes out symmetric
     * about d = 15.5 without being made to. */
    static const int TAP[32] = {
        3, 2, 0, 1, 7, 6, 5, 4, 11, 10, 9, 8, 15, 14, 13, 12,
        12, 13, 14, 15, 8, 9, 10, 11, 4, 5, 6, 7, 1, 0, 2, 3
    };
    float hist[64]; int hp = 0;
    int j, i;
    long warm;
    double frac = (double)o / EB_WT_RES_OVER;
    float ring[512], nring[512]; int rp = 0;
    float pprev, uprev = 0.0f;
    int edge = -1, got = 0;
    memset(&s,0,sizeof s); memset(hist,0,sizeof hist);
    fill(&c, g_build_inc, pw, arm);
    (void)j;
    /* THE STARTING PHASE IS SOLVED BACKWARDS from the known edge phase, so the
     * crossing lands at exactly `frac` of the way through a sample -- which is
     * the quantity the tick measures and uses to pick a sub-position.
     *
     * Shifting a fixed start by frac*dp instead moves the edge by frac but
     * leaves an arbitrary BASELINE: the edge falls at frac((pe-p0)/dp), and
     * that is not zero. Measured as roughly half a sample -- the dumped error
     * around one edge showed the wavetable's transition running that far ahead
     * of the port's, peak 0.216 on a signal of 0.85.
     *
     * THIS WAS TRIED ONCE AND FAILED, and the reason it works now is worth
     * keeping: the crossing is DETECTED in sample M for frac 0 and M+1
     * otherwise, so `edge` jumps by one between sub-positions. While the
     * window carried a hand-tuned +1 offset those two shifts fought each
     * other. The window is now anchored at the detection sample itself, so a
     * jump in `edge` moves the window with it and cancels. */
    s.phase = (float)p0_in;
    memset(ring, 0, sizeof ring); memset(nring, 0, sizeof nring);
    for (i = 0; i < 20000 && !got; ++i) {
        float q[4], y, u;
        pprev = s.phase;
        uprev = (((s.subcnt + s.phase) + 1.0f) * 0.5f) - 1.0f;
        q[0]=eb_dco_step(&s,&c); q[1]=eb_dco_step(&s,&c);
        q[2]=eb_dco_step(&s,&c); q[3]=eb_dco_step(&s,&c);
        hist[hp & 63] = q[0]; hist[(hp+1) & 63] = q[1];
        hist[(hp+2) & 63] = q[2]; hist[(hp+3) & 63] = q[3];
        hp += 4;
        {   int d; double acc = 0.0;
            for (d = 0; d < 32; ++d)
                acc += (double)hist[(hp - 1 - d) & 63] * RC_fir[TAP[d]];
            y = (float)acc;
        }
        u = (((s.subcnt + s.phase) + 1.0f) * 0.5f) - 1.0f;
        ring[rp & 511] = y;
        /* THE REFERENCE IS WHAT THE TICK PRODUCES, sample for sample -- not
         * two constants read off the window's ends. The saw is a RAMP, so a
         * constant reference leaves the ramp inside the residual, and the
         * residual then has to carry a whole period of signal instead of one
         * edge. Computed here from the phase AFTER the four sub-steps, which
         * is the phase eb_dco_wt_tick has when it emits this sample. */
        {   float pn = s.phase, tn = c.pw + pn;
            float un = (((s.subcnt + pn) + 1.0f) * 0.5f) - 1.0f;
            /* THE SAW'S PHASE CARRIES THE GROUP DELAY, exactly as
             * eb_dco_wt_tick does. The reference the residual is measured
             * against must be the flat path the tick actually computes, term
             * for term -- a reference that differs from the tick by anything
             * puts that difference into every residual. */
            float pd = pn - 3.875f * (4.0f * g_build_inc);
            if (pd < -1.0f) pd += 2.0f;   /* wrapped, as the tick wraps it */
            nring[rp & 511] =
                (arm == ARM_SAW)   ? (pd * c.gn_saw) * c.sat_hi :
                (arm == ARM_PULSE) ? (tn < 0.0f ? -c.gn_pulse : c.gn_pulse)
                                     * c.sat_hi
                                   : (un < 0.0f ? -c.gn_sub : c.gn_sub)
                                     * c.sat_hi;
        }
        if (edge < 0 && i > 200) {
            int hit = 0;
            /* THE FRACTION THE TICK WOULD MEASURE, computed here the same way
             * eb_dco_wt.c computes it, so the two can be COMPARED instead of
             * assumed equal. Printed under EB_WT_TRACEFRAC. */
            double dpo = (double)c.inc * 4.0;
            /* THE SUB'S FRACTION IS ITS OWN. Its ramp's sign is the counter,
             * and the counter toggles at the rising crossing of subthr (near
             * -0.005) -- NOT at the phase wrap. Using the wrap's fraction here
             * indexed every sub residual by a position half a period from the
             * edge it was meant to describe. */
            /* THE SAW IS ANCHORED ON ITS DELAYED PHASE, exactly as
             * eb_dco_wt_tick schedules it. Its flat path is the ramp
             * pd = p - 3.875*inc, so its step happens 3.875 samples after the
             * phase wrap; anchoring the table on the wrap and the tick on the
             * step let the two round into different samples, and one edge in a
             * few tens was then corrected in the wrong sample entirely. */
            double gd = 3.875 * dpo;
            double pdp = (double)pprev - gd, pdn = (double)s.phase - gd;
            if (pdp < -1.0) pdp += 2.0;
            if (pdn < -1.0) pdn += 2.0;
            double fr = (which == 1) ? (-(double)(pw + pprev) / dpo)
                      : (which == 2) ? (((double)RC_subthr - (double)pprev)
                                        / dpo)
                      : (arm == ARM_SAW) ? ((1.0 - pdp) / dpo)
                                     : ((1.0 - (double)pprev) / dpo);
            if (getenv("EB_WT_TRACEFRAC")) { /* set below once hit is known */ }
            (void)fr;
            if (which == 0 && (arm == ARM_SAW ? (pdn < pdp)
                                             : (s.phase < pprev))) hit = 1;
            if (which == 1 && s.phase >= pprev
                && ((pw + pprev) < 0.0f) != ((pw + s.phase) < 0.0f))
                hit = 1;
            if (which == 2 && (uprev < 0.0f) != (u < 0.0f)) hit = 1;
            if (hit) { edge = rp; *frac_out = fr; }
        }
        /* stop once the window's far end has been rendered; the decimator's
         * own group delay of ~4 samples is inside the window and must be */
        if (edge >= 0 && rp - edge >= HALF + 12) got = 1;
        ++rp;
    }
    warm = 0; (void)warm; (void)frac;
    /* CENTRE ON THE OUTPUT EDGE, NOT THE PHASE EDGE. The port's decimator has
     * 3.875 samples of group delay, so the step appears in the OUTPUT about
     * four samples after the phase crossing that caused it. Centring on the
     * phase edge left the residual having to cancel a step at tap 32 and
     * re-create it at tap 36 -- a correction as large as the signal, peak
     * 1.03, which is the opposite of what a residual is for.
     *
     * Located by scanning for the midpoint crossing rather than by subtracting
     * a constant, so the delay is measured from the chain each time instead of
     * being a number that could go stale. */
    /* CENTRED ON THE PHASE EDGE, which is where the TICK writes its residual.
     * Centring on the OUTPUT edge instead looks tidier -- the residual comes
     * out small and symmetric -- but it is WRONG, because the tick's flat
     * reference steps at the phase edge and the two must agree about where
     * tap HALF is. Measured both ways: output-centred gave RMS 1.10 against
     * the reference's 0.81, because the step height was then taken across the
     * ramp instead of across the step.
     *
     * The FIR's 3.875 samples of group delay therefore live INSIDE the
     * residual, which makes it larger. That is the honest shape: the residual
     * has to move the edge as well as band-limit it. */
    /* THE WINDOW IS PLACED AT THE PHASE-EDGE SAMPLE, THE SAME PLACE FOR EVERY
     * SUB-POSITION -- and this is the bug that made sixteen sub-positions
     * behave exactly like four.
     *
     * The earlier version RE-DETECTED the output edge per sub-position and
     * centred on it. Detection has integer resolution, so re-centring removed
     * the very fractional offset the sub-position exists to encode: all
     * sixteen tables came out nearly identical, and raising the resolution
     * changed the measured residual by 0.0 dB.
     *
     * The tick writes its residual at the sample where it DETECTS the phase
     * edge, so the generator must place tap HALF at that same sample. The
     * FIR's 3.875 samples of group delay then live inside the residual, which
     * is where they belong: the correction has to move the edge as well as
     * band-limit it. */
    {   /* +1: MEASURED, by comparing the generated table against the
         * decomposition printed by tools/engineb/wt_decomp.c. The generated
         * row was ground truth shifted one sample later -- generated[k+1] =
         * truth[k] -- because `edge` is the index of the sample DURING which
         * the sign change was detected, and the tick's naive has already
         * stepped by the time it emits that sample. */
        /* TAP HALF SITS AT THE DETECTION SAMPLE, and this is derived rather
         * than tuned. With the flat path delayed by HALF, the module's output
         * at time m is flat(m-HALF) plus the residuals; requiring that to
         * equal the port's output gives
         *
         *     R[i] = (port(n + i - HALF) - flat(n + i - HALF)) / h
         *
         * for an edge detected at sample n. So the window is anchored at n --
         * `edge` itself, with no offset -- and the reference is the TICK's own
         * flat value at each sample.
         *
         * The +1 that used to be here, and the two-constant reference it went
         * with, were each tuned against the other. One definition replaces
         * both. */
        int oe = edge;
        for (i = 0; i < EB_WT_RES_LEN; ++i) {
            int j = oe + (i - HALF);
            out[i]  = (j >= 0 && j < rp) ? ring[j & 511]  : 0.0f;
            nout[i] = (j >= 0 && j < rp) ? nring[j & 511] : 0.0f;
        }
    }
}

/* `mips` turns the first dimension from PULSE-WIDTH SLICES into PITCH LEVELS.
 * Only the sub uses it (eb_dco_wt.h, finding 9). */
static void emit2(const char *name, float pw, int arm, int which,
                  int slices, float lo, float hi, int mips)
{
    int sl, o, i, nsl = mips ? mips : (slices ? slices : 1);
    printf("static const float %s[%d][%d][%d] = {\n", name, nsl,
           EB_WT_RES_OVER + 1, EB_WT_RES_LEN);
    for (sl = 0; sl < nsl; ++sl) {
        /* THE PULSE'S MOVING EDGE IS SLICED BY EDGE WIDTH. Slice sl covers
         * u = 1 - pw in 2^e*[1+j/16, 1+(j+1)/16) with e = EB_WT_PWA_EMIN +
         * sl/16 and j = sl%16, and is built at that interval's MIDPOINT --
         * the same split the tick makes from u's exponent and mantissa. */
        float w = pw;
        if (!mips && slices) {
            if (arm == ARM_PULSE && which == 1) {
                int e2 = EB_WT_PWA_EMIN + sl / EB_WT_PWA_PER_OCT;
                int j  = sl % EB_WT_PWA_PER_OCT;
                float u = 1.0f + ((float)j + 0.5f) / EB_WT_PWA_PER_OCT;
                int k;
                for (k = 0; k < -e2; ++k) u *= 0.5f;
                for (k = 0; k < e2; ++k)  u *= 2.0f;
                w = 1.0f - u;
            } else {
                w = lo + (hi - lo) * (sl + 0.5f) / slices;
            }
        }
        if (mips) {
            /* Level L = 4*e + j covers inc in INC0*2^e*[1+j/4, 1+(j+1)/4) and
             * is built at that interval's MIDPOINT -- the same split the tick
             * makes from the exponent and the top two mantissa bits. */
            int e2 = sl / EB_WT_SUB_PER_OCT, j = sl % EB_WT_SUB_PER_OCT, k;
            g_build_inc = EB_WT_SUB_INC0;
            for (k = 0; k < e2; ++k) g_build_inc *= 2.0f;
            g_build_inc *= 1.0f + ((float)j + 0.5f) / (float)EB_WT_SUB_PER_OCT;
            printf("  { /* mip %d, inc %.5f */\n", sl, g_build_inc);
        } else
        printf("  { /* pw %.4f */\n", w);
        /* OVER+1 ROWS, not OVER. The tick blends row `sub` with row `sub+1`,
         * and the LAST row had no partner: it fell back to itself, which is
         * the un-interpolated nearest-neighbour case the whole oversampling
         * exists to remove. Where a pitch makes the crossing fraction sit in
         * that top slot the saw collapsed -- -19.2 dB at inc 0.014 between
         * -53.3 and -44.7 either side. The extra row is the SAME edge at
         * fraction 1.0, which the solver builds like any other. */
        for (o = 0; o <= EB_WT_RES_OVER; ++o) {
            float y[EB_WT_RES_LEN], nvw[EB_WT_RES_LEN];
            double lvl0, lvl1, h;
            /* SOLVE p0 BY ITERATION, because solving it in closed form does
             * not land. MEASURED: the closed form leaves a constant offset of
             * 0.028 samples AND puts sub-position 0 at an actual fraction of
             * 0.9721 -- a WHOLE SAMPLE out, on the entry the tick asks for
             * most often.
             *
             * frac is linear in p0, so one Newton step converges; two are
             * taken and the result is asserted. This replaces a formula that
             * was right in principle with a loop that is right in fact. */
            {   double dp = 4.0 * (double)g_build_inc;
                /* THE EDGE PHASE, per arm: the pulse's moving edge is at
                 * t = pw + p = 0, the sub's is at the counter's toggle
                 * p = subthr, and the saw's (and the pulse's fixed edge) is
                 * the phase wrap at p = 1. */
                double pe = (which == 1) ? -(double)w
                          : (which == 2) ? (double)RC_subthr : 1.0;
                /* ROW 0 IS BUILT A HAIR ABOVE ZERO, and this is the fault
                 * that made the saw a lottery in pitch.
                 *
                 * At target EXACTLY 0 the crossing sits on the sample
                 * boundary, and the detection then lands in the sample BEFORE
                 * the one every other row is detected in. Row 0 came out
                 * holding row 63's content: the saw's rows form one smooth
                 * family whose peak runs +0.493 down through zero to -0.501
                 * across the sub-positions, and row 0 sat at -0.492, which is
                 * row 63's value, a whole sample out.
                 *
                 * Any crossing landing in the first 1/64 of a sample was then
                 * corrected one sample late. MEASURED, by refusing to use row
                 * 0 at all: inc 0.0115 goes -29.2 to -59.7 dB and inc 0.0155
                 * goes -30.0 to -48.3, while every other pitch does not move.
                 *
                 * A quarter of a sub-position above zero puts the crossing
                 * unambiguously inside the sample. The position error is
                 * 1/256 of a sample, which is far below what the resolution
                 * itself carries, and it costs nothing at run time -- a
                 * clamp in the tick would have cost a compare per edge. */
                /* AND THE TOP ROW IS PULLED THE SAME QUARTER BELOW ONE, for
                 * the same reason mirrored. A target of exactly 1.0 puts the
                 * crossing on the far boundary, where detection lands a sample
                 * LATER than the rows below it. That was the pulse's own
                 * outlier -- -31.3 dB at inc 0.0115 with the module running a
                 * sample EARLY, the exact mirror of row 0's late edge. */
                double target = (o == 0) ? (0.25 / EB_WT_RES_OVER)
                              : (o == EB_WT_RES_OVER)
                                  ? (1.0 - 0.25 / EB_WT_RES_OVER)
                                  : ((double)o / EB_WT_RES_OVER);
                double p0 = pe - dp * (200.0 + target), got = -1.0;
                int it;
                p0 = fmod(p0 + 1.0, 2.0); if (p0 < 0.0) p0 += 2.0; p0 -= 1.0;
                for (it = 0; it < 6; ++it) {
                    build_one(w, arm, which, o, y, nvw, p0, &got);
                    if (fabs(got - target) < 1e-4) break;
                    /* frac = frac((pe - p0)/dp), so frac RISES as p0 FALLS:
                     * moving from `got` to `target` means p0 -= (target-got)*dp,
                     * i.e. += (got-target)*dp. The first version had this the
                     * other way and the iteration walked away from the answer
                     * instead of onto it. */
                    p0 += (got - target) * dp;
                    p0 = fmod(p0 + 1.0, 2.0);
                    if (p0 < 0.0) p0 += 2.0;
                    p0 -= 1.0;
                }
                if (getenv("EB_WT_TRACEFRAC"))
                    fprintf(stderr, "  arm%d which%d o=%2d target %.4f "
                            "got %.4f after %d\n", arm, which, o, target,
                            got, it);
            }
            /* THE TWO SETTLED LEVELS, read from the window's own ends.
             *
             * The tick's own per-sample reference was tried instead and is
             * WORSE -- -3.8 dB against this form's -19.9 at 441 Hz -- because
             * the window is centred on the OUTPUT edge while that reference
             * steps at the PHASE edge four samples earlier, so the height came
             * out as the saw's ramp slope rather than its step. Both
             * formulations were measured; this is the one that wins, and the
             * other is recorded so it is not retried blind. */
            /* TWO SETTLED LEVELS, and this is MEASURED to be the better of
             * the two forms even though the other is the one that is right in
             * principle.
             *
             * The tick's own per-sample flat path is the correct reference on
             * paper. Built that way the module measures WORSE at every pitch
             * and on every arm -- saw -11.4 dB against this form's -16.7,
             * pulse -15.6 against -27.0. The reason is the build pitch: the
             * per-sample reference carries the saw's RAMP, whose slope depends
             * on pitch, so a residual built at 22 Hz and played at 441 carries
             * the wrong ramp. Two constants leave the ramp entirely to the
             * tick, where it is exact at every pitch.
             *
             * Both were built and measured. The one that wins is here; the one
             * that is prettier is recorded so it is not retried blind. */
            /* h IS THE LARGEST JUMP IN THE REFERENCE, located by scanning.
             *
             * Taking it at tap HALF assumes the flat path steps exactly at the
             * detection sample. That is true for the pulse and the sub, and
             * FALSE for the saw: its phase carries the decimator's group
             * delay, so its ramp wraps 3.875 samples LATER. Taking the
             * difference at HALF then gives the ramp's SLOPE -- a near-zero
             * divisor -- and the saw table came out with entries of 441 and
             * -330 where it should hold numbers near 1.
             *
             * Nothing else in the window comes close to the step, so the
             * largest jump is it, whichever tap it falls on. */
            {   int q; double bj = 0.0;
                lvl0 = lvl1 = 0.0;
                for (q = 1; q < EB_WT_RES_LEN; ++q) {
                    double d = (double)nvw[q] - (double)nvw[q - 1];
                    if (fabs(d) > fabs(bj)) { bj = d; lvl0 = nvw[q-1];
                                              lvl1 = nvw[q]; }
                }
                h = bj;
            }
            if (fabs(h) < 1e-9) h = 1.0;
            printf("    {");
            for (i = 0; i < EB_WT_RES_LEN; ++i) {
                double naive = nvw[i];
                /* %.9e, not %.9g: %g prints a clean zero as "0", and "0f" is
                 * an invalid integer suffix, not a float. The generator's own
                 * output failed to compile on it. */
                printf("%s%.9ef", i ? "," : "", (y[i] - naive) / h);
            }
            printf("},\n");
        }
        printf("  },\n");
    }
    printf("};\n\n");
}

static void emit(const char *name, float pw, int arm, int which,
                 int slices, float lo, float hi)
{
    int sl, o, i;
    printf("static const float %s[%d][%d][%d] = {\n", name,
           slices ? slices : 1, EB_WT_RES_OVER, EB_WT_RES_LEN);
    for (sl = 0; sl < (slices ? slices : 1); ++sl) {
        float w = slices ? lo + (hi - lo) * (sl + 0.5f) / slices : pw;
        long n, e;
        float *nv;
        double height, dsub;
        eb_dco_coef cc;
        float phe, ue;
        float *v = trace(w, arm, which, &n, &e, &nv, &height, &cc, &dsub,
                         &phe, &ue);
        if (fabs(height) < 1e-12) height = 1.0;
        printf("  { /* pw %.4f */\n", w);
        for (o = 0; o < EB_WT_RES_OVER; ++o) {
            double frac = (double)o / EB_WT_RES_OVER;
            printf("    {");
            for (i = 0; i < EB_WT_RES_LEN; ++i) {
                double t = (double)e + ((double)(i - HALF) + frac) * OS;
                double nvi = naive_at(&cc, arm, (double)phe, dsub,
                                      t - (double)e, (double)ue);
                printf("%s%.9gf", i ? "," : "",
                       (lp(v, n, t) - nvi) / height);
            }
            printf("},\n");
        }
        printf("  },\n");
        free(v); free(nv);
    }
    printf("};\n\n");
}

int main(void)
{
    printf("/* GENERATED by tools/engineb/gen_wt_tables.c -- do not edit.\n"
           " * Residuals for eb_dco_wt.c, built by RUNNING eb_dco_step so they\n"
           " * cannot drift from the oscillator they correct. No pitch\n"
           " * dimension: the edge width in samples is |pw-1|/(8*amp) and inc\n"
           " * cancels, MEASURED at 2.4290 samples across five octaves. */\n");
    printf("#ifndef ENGINEB_EB_WT_TABLES_H\n#define ENGINEB_EB_WT_TABLES_H\n\n");
    emit2("eb_wt_res_saw",     RC_pw, ARM_SAW,   0, 0, 0, 0, 0);
    g_build_inc = BUILD_INC;
    emit2("eb_wt_res_sub",     RC_pw, ARM_SUB,   2, 0, 0, 0,
          EB_WT_SUB_MIPS);
    g_build_inc = BUILD_INC;
    emit2("eb_wt_res_pulse_a", 0.0f,  ARM_PULSE, 1, EB_WT_PW_SLICES,
         EB_WT_PW_LO, EB_WT_PW_LO + EB_WT_PW_STEP * EB_WT_PW_SLICES, 0);
    emit2("eb_wt_res_pulse_b", 0.0f,  ARM_PULSE, 0, EB_WT_PWB_SLICES,
         EB_WT_PW_LO, EB_WT_PW_LO + EB_WT_PW_STEP * EB_WT_PW_SLICES, 0);
    printf("#endif\n");
    return 0;
}
