/* test_teensy_golden.c — replay the standalone 44.1 kHz golden corpus and verify
 * each scenario's output hash. Runs on the host (proving the golden matches the
 * current build — a regression guard) and compiles for the Teensy 4.1 (proving
 * the ARM build reproduces the x86 reference, hence the plugin, bit-for-bit).
 *
 * The corpus (tests/teensy_golden.h, generated by tools/verify/gen_teensy_golden.py)
 * embeds each patch blob + note events + the expected FNV-1a-64 hash of the port's
 * stereo float output. This driver reconstructs a minimal 1-patch bank from the
 * embedded blob, applies it, replays the events at their sample offsets, hashes the
 * rendered bytes, and compares. Self-contained: no bank file needed on the target.
 */
#include <stdio.h>
#include <stdlib.h>
#include <string.h>
#include <stdint.h>
#include "teensy_golden.h"

/* Public engine API (gui/juno_bridge.c). Opaque context. */
typedef struct juno_ctx juno_ctx;
juno_ctx *juno_gui_create(float sample_rate, int chorus_mode);
int  juno_gui_apply_bank(juno_ctx *c, const unsigned char *bank, int len, int idx);
void juno_gui_note_on(juno_ctx *c, int midi_note, int velocity);
void juno_gui_note_off(juno_ctx *c, int midi_note);
int  juno_gui_render(juno_ctx *c, float *out, int nframes);
void juno_gui_destroy(juno_ctx *c);

/* Bank layout (tools/verify/e2e_emu.py: HEADER=23, STRIDE=20223, BLOB_OFF=16). */
#define BK_HEADER 23
#define BK_STRIDE 20223
#define BK_BLOB   16

static uint64_t fnv_init(void) { return 0xcbf29ce484222325ULL; }
static uint64_t fnv_bytes(uint64_t h, const unsigned char *p, int n)
{
    int i;
    for (i = 0; i < n; ++i) { h ^= p[i]; h *= 0x100000001b3ULL; }
    return h;
}

/* Set when an allocation fails, so the scenario reports FAIL and the run
 * continues. The old code called exit(2): on a desktop that is a clean abort,
 * but on bare metal under --specs=nosys.specs exit() spins forever with nothing
 * printed -- a silent hang, the exact failure mode this corpus must never have. */
static int g_tg_oom;

/* Render `n` frames and fold their raw bytes into the running hash. */
static uint64_t render_hash(juno_ctx *c, uint64_t h, int n)
{
    float *buf = (float *)malloc(sizeof(float) * 2 * n);
    if (!buf) { g_tg_oom = 1; return h; }
    juno_gui_render(c, buf, n);
    h = fnv_bytes(h, (const unsigned char *)buf, (int)(sizeof(float) * 2 * n));
    free(buf);
    return h;
}

static int run_scenario(const tg_scenario *s, int idx, int total)
{
    /* Announce BEFORE the work, not after. The first silicon run printed only
     * completed scenarios, so a stall looked like "stuck on scenario 1" when
     * scenario 1 had in fact finished and scenario 2 was the dead one. */
    printf("[%d/%d] %-14s patch %2d  %d frames ...\n",
           idx + 1, total, s->name, s->patch, s->nframes);
    g_tg_oom = 0;
    /* minimal 1-patch bank: sentinel 'K' + the embedded TG_BLOB_LEN-byte record
     * prefix. Must copy the FULL embedded blob: the per-patch DELAY FEEDBACK /
     * DIRECT LEVEL bytes live at record 3057/3060, and the old hardcoded 704-byte
     * copy silently zeroed them (invisible while feedback was a constant; exposed
     * the moment the per-patch law landed). */
    unsigned char *bank = (unsigned char *)calloc(1, BK_HEADER + BK_STRIDE);
    if (!bank) { printf("FAIL: %-14s bank alloc\n", s->name); return 2; }
    bank[0] = 'K';
    memcpy(bank + BK_HEADER + BK_BLOB, s->blob, TG_BLOB_LEN);

    juno_ctx *c = juno_gui_create(TG_RATE, 0);
    /* The context is 12 MB (JUNO_STATE_BYTES). On a desktop a failure here is
     * unthinkable and a leak is invisible; on the Daisy the whole SDRAM pool is
     * 13 MB, so scenario 2 gets NULL and the board dies on the next call. Both
     * the check and the matching destroy below are load-bearing on target. */
    if (!c) { free(bank); printf("FAIL: %-14s alloc\n", s->name); return 2; }
    juno_gui_apply_bank(c, bank, BK_HEADER + BK_STRIDE, 0);

    uint64_t h = fnv_init();
    int cur = 0, i;
    for (i = 0; i < s->nev; ++i) {
        const tg_event *e = &s->ev[i];
        if (e->at > cur) { h = render_hash(c, h, e->at - cur); cur = e->at; }
        if (e->kind == 1) juno_gui_note_on(c, e->note, e->vel);
        else              juno_gui_note_off(c, e->note);
    }
    if (s->nframes > cur) h = render_hash(c, h, s->nframes - cur);

    free(bank);
    juno_gui_destroy(c);
    if (g_tg_oom) {
        printf("FAIL: %-14s patch %2d  render buffer alloc failed\n", s->name, s->patch);
        return 1;
    }
    if (h != s->hash) {
        /* Two 32-bit halves, not %016llx: newlib-nano's vsnprintf -- which is
         * what the Daisy logger uses -- does not implement the ll length
         * modifier and printed a literal "lx" on target, so every hash in the
         * first full silicon log was unreadable. The verdict was still sound
         * (the comparison is on the value, not the text), but a corpus whose
         * printed hash cannot be compared by hand is only half a diagnostic. */
        printf("FAIL: %-14s patch %2d  got %08lx%08lx  want %08lx%08lx\n",
               s->name, s->patch,
               (unsigned long)(h >> 32), (unsigned long)(h & 0xFFFFFFFFu),
               (unsigned long)(s->hash >> 32), (unsigned long)(s->hash & 0xFFFFFFFFu));
        return 1;
    }
    printf("OK:   %-14s patch %2d  hash %08lx%08lx\n",
           s->name, s->patch,
           (unsigned long)(h >> 32), (unsigned long)(h & 0xFFFFFFFFu));
    return 0;
}

int main(void)
{
    int i, bad = 0;
    for (i = 0; i < TG_NSCEN; ++i) bad += run_scenario(&tg_scenarios[i], i, TG_NSCEN);
    if (bad) { printf("FAIL: %d/%d golden scenarios diverged\n", bad, TG_NSCEN); return 1; }
    printf("ALL OK: %d/%d Teensy golden scenarios bit-exact\n", TG_NSCEN, TG_NSCEN);
    return 0;
}
